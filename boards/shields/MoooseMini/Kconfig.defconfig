## boards/shields/MoooseMini/Kconfig.defconfig
```kconfig
if SHIELD_MoooseMini

config ZMK_KEYBOARD_NAME
    default "MoooseMini"

config ZMK_USB
	default y

config ZMK_BLE
	default y

endif
```

## config/west.yml
```yaml
manifest:
  remotes:
    - name: zmkfirmware
      url-base: https://github.com/zmkfirmware
    - name: ataruno-git
      url-base: https://github.com/ataruno
    - name: caksoylar
      url-base: https://github.com/caksoylar
  projects:
    - name: zmk
      remote: zmkfirmware
      revision: main
      import: app/west.yml
    - name: zmk-pmw3610-driver
      remote: ataruno-git
      revision: main
    - name: zmk-layout-shift
      remote: kot149
      revision: v1
    - name: zmk-scroll-snap
      remote: kot149
      revision: v1
    - name: zmk-mouse-gesture
      remote: kot149
      revision: v1
    - name: zmk-listeners
      remote: ssbb
      revision: v1
    - name: zmk-rgbled-widget
      remote: caksoylar
      revision: main
  self:
    path: config
```
